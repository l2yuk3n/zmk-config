## config/boards/arm/le_jlwffre/Kconfig.board
```kconfig
# Copyright (c) 2024 The ZMK Contributors
# SPDX-License-Identifier: MIT

config BOARD_LE_JLWFFRE
    bool "le jlwffre"
    depends on SOC_NRF52840_QIAA
```

## config/boards/arm/le_jlwffre/Kconfig.defconfig
```kconfig
# Copyright (c) 2024 The ZMK Contributors
# SPDX-License-Identifier: MIT

if BOARD_LE_JLWFFRE

config ZMK_KEYBOARD_NAME
    default "JHL-jlwffre"

config BT_CTLR
    default BT

config ZMK_SLEEP
    default y

endif # BOARD_LE_JLWFFRE
```

## config/boards/arm/le_jlwffre/le_jlwffre_defconfig
```kconfig
# SPDX-License-Identifier: MIT

CONFIG_SOC_SERIES_NRF52X=y
CONFIG_SOC_NRF52840_QIAA=y
CONFIG_BOARD_LE_JLWFFRE=y

# Enable MPU
CONFIG_ARM_MPU=y

# Enable GPIO
CONFIG_GPIO=y

CONFIG_USE_DT_CODE_PARTITION=y
CONFIG_BUILD_OUTPUT_UF2=y

CONFIG_MPU_ALLOW_FLASH_WRITE=y
CONFIG_NVS=y
CONFIG_SETTINGS_NVS=y
CONFIG_FLASH=y
CONFIG_FLASH_PAGE_LAYOUT=y
CONFIG_FLASH_MAP=y

# Enable I2C
CONFIG_I2C=y
CONFIG_ZMK_BATTERY_REPORTING_FETCH_MODE_STATE_OF_CHARGE=y

# Soft Off
CONFIG_ZMK_PM_SOFT_OFF=y

CONFIG_ZMK_BLE=y
CONFIG_ZMK_USB=y
```

## config/boards/shields/chocv/Kconfig.defconfig
```kconfig
if SHIELD_CHOCV_DONGLE

config ZMK_KEYBOARD_NAME
    default "JHL-ChocV-D"

config ZMK_SPLIT_ROLE_CENTRAL
    default y

# Should not need this???
config ZMK_USB
    default y

config ZMK_SPLIT
    default y

config ZMK_SPLIT_BLE_CENTRAL_PERIPHERALS
    default 1

config BT_MAX_CONN
    default 5

config BT_MAX_PAIRED
    default 5

endif


if SHIELD_CHOCV

config ZMK_KEYBOARD_NAME
    default "JHL-ChocV"

endif
```

## config/boards/shields/chocv/Kconfig.shield
```kconfig
config SHIELD_CHOCV
    def_bool $(shields_list_contains,chocv)

config SHIELD_CHOCV_DONGLE
    def_bool $(shields_list_contains,chocv_dongle)
```

## config/boards/shields/dogtag/Kconfig.defconfig
```kconfig
# Copyright (c) 2022 The ZMK Contributors
# SPDX-License-Identifier: MIT

if SHIELD_DOGTAG

config ZMK_KEYBOARD_NAME
    default "JHL-dogtag"

endif
```

## config/boards/shields/dogtag/Kconfig.shield
```kconfig
# Copyright (c) 2022 The ZMK Contributors
# SPDX-License-Identifier: MIT

config SHIELD_DOGTAG
    def_bool $(shields_list_contains,dogtag)
```

## config/boards/shields/grumpy/Kconfig.defconfig
```kconfig
# Copyright (c) 2022 The ZMK Contributors
# SPDX-License-Identifier: MIT

if SHIELD_GRUMPY

config ZMK_KEYBOARD_NAME
    default "JHL-grumpy"

endif
```

## config/boards/shields/grumpy/Kconfig.shield
```kconfig
# Copyright (c) 2022 The ZMK Contributors
# SPDX-License-Identifier: MIT

config SHIELD_GRUMPY
    def_bool $(shields_list_contains,grumpy)
```

## config/boards/shields/janus/Kconfig.defconfig
```kconfig
# Copyright (c) 2022 The ZMK Contributors
# SPDX-License-Identifier: MIT

if SHIELD_JANUS_LEFT

config ZMK_KEYBOARD_NAME
    default "JHL-janus"

config ZMK_SPLIT_ROLE_CENTRAL
    default y

endif

if SHIELD_JANUS_LEFT || SHIELD_JANUS_RIGHT
config ZMK_SPLIT
    default y
endif
```

## config/boards/shields/janus/Kconfig.shield
```kconfig
# Copyright (c) 2022 The ZMK Contributors
# SPDX-License-Identifier: MIT

config SHIELD_JANUS_LEFT
    def_bool $(shields_list_contains,janus_left)

config SHIELD_JANUS_RIGHT
    def_bool $(shields_list_contains,janus_right)
```

## config/boards/shields/pandy/Kconfig.defconfig
```kconfig
# Copyright (c) 2020 The ZMK Contributors
# SPDX-License-Identifier: MIT

if SHIELD_PANDY

config ZMK_KEYBOARD_NAME
    default "JHL-pandy"

endif
```

## config/boards/shields/pandy/Kconfig.shield
```kconfig
# Copyright (c) 2020 The ZMK Contributors
# SPDX-License-Identifier: MIT

config SHIELD_PANDY
   def_bool $(shields_list_contains,pandy)
```

## config/boards/shields/rollow/Kconfig.defconfig
```kconfig
if SHIELD_ROLLOW_DONGLE

config ZMK_KEYBOARD_NAME
	default "JHL-ROLLOW"

config ZMK_SPLIT_ROLE_CENTRAL
	default y

config ZMK_USB
	default y

config ZMK_SPLIT_BLE_CENTRAL_PERIPHERALS
	default 2

# Set this to ZMK_SPLIT_BLE_CENTRAL_PERIPHERALS + your desired number of BT profiles (default is 5)
config BT_MAX_CONN
	default 7

# Set this to the same number as BT_MAX_CONN
config BT_MAX_PAIRED
    default 7

endif


if SHIELD_ROLLOW_LEFT

config ZMK_KEYBOARD_NAME
    default "JHL-ROLLOW_L"

config ZMK_SPLIT_ROLE_CENTRAL
	default y

endif


if SHIELD_ROLLOW_RIGHT

config ZMK_KEYBOARD_NAME
    default "JHL-ROLLOW_R"

endif


if SHIELD_ROLLOW_LEFT || SHIELD_ROLLOW_RIGHT || SHIELD_ROLLOW_DONGLE

config ZMK_SPLIT
	default y

endif
```

## config/boards/shields/swweeep/Kconfig.defconfig
```kconfig
# Copyright (c) 2022 The ZMK Contributors
# SPDX-License-Identifier: MIT

if SHIELD_SWWEEEP_LEFT

config ZMK_KEYBOARD_NAME
    default "JHL-swweeep"

config ZMK_SPLIT_ROLE_CENTRAL
    default y

endif

if SHIELD_SWWEEEP_LEFT || SHIELD_SWWEEEP_RIGHT
config ZMK_SPLIT
    default y
endif
```

## config/boards/shields/tri_artsey/Kconfig.defconfig
```kconfig
# Copyright (c) 2022 The ZMK Contributors
# SPDX-License-Identifier: MIT

if SHIELD_TRI_ARTSEY

config ZMK_KEYBOARD_NAME
    default "triARTSEY"

endif
```

## config/boards/shields/tri_artsey/Kconfig.shield
```kconfig
# Copyright (c) 2022 The ZMK Contributors
# SPDX-License-Identifier: MIT

config SHIELD_TRI_ARTSEY
    def_bool $(shields_list_contains,tri_artsey)
```

## config/boards/shields/ven_xiao/Kconfig.defconfig
```kconfig
# Copyright (c) 2022 The ZMK Contributors
# SPDX-License-Identifier: MIT

if SHIELD_VEN_XIAO
  
config ZMK_KEYBOARD_NAME
    default "venXiao"

endif
```
