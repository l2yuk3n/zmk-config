#include <behaviors.dtsi>
#include <dt-bindings/zmk/keys.h>
#include <dt-bindings/zmk/bt.h>
#include <dt-bindings/zmk/outputs.h>

// Colemak gets turned on in the ardux.dtsi file
// ARST Row
#define KEY_A 0
#define KEY_R 1
#define KEY_T 2
#define KEY_S 3
// NEIO Row
#define KEY_E 4
#define KEY_Y 5
#define KEY_I 6
#define KEY_O 7

// Define Offsets
#define LEADING_NONES NONE(0, 0, 0)
#define MIDDLE_NONES NONE(0, 0, 0)
#define TRAILING_NONES NONE(0, 0, 0)


// Include main ardux.io keymap
#include "../../../ardux.dtsi"
