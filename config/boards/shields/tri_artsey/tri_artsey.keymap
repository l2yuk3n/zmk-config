#include <behaviors.dtsi>
#include <dt-bindings/zmk/keys.h>
#include <dt-bindings/zmk/bt.h>
#include <dt-bindings/zmk/outputs.h>

// Colemak gets turned on in the ardux.dtsi file
// ARST Row
#define KEY_A 3
#define KEY_R 2
#define KEY_T 1
#define KEY_S 0
// NEIO Row
#define KEY_E 7
#define KEY_Y 6
#define KEY_I 5
#define KEY_O 4

// Define Offsets
#define LEADING_NONES NONE(0, 0, 0)
#define MIDDLE_NONES NONE(0, 0, 0)
#define TRAILING_NONES NONE(0, 0, 0)


// Include main ardux.io keymap
#include "../../../ardux.dtsi"
